//********************************************************* 
/*  文件名：TEST_61F13x_SLEEP.c
*	功能：  FT61F13x-SLEEP功能演示
*   IC:     FT61F135  SOP16
*   晶振：  16M/4T                    
*   说明：  此程序为FT61F13x-SLEEP睡眠演示程序，上电之后led1、led2同时置高约4s，
*           然后置低，进入睡眠。测试FT61F13x的睡眠功耗。
*
*                 FT61F135  SOP20
*                 ----------------
*  VDD-----------|1(VDD)   (VSS)20|-----------VSS     
*  NC------------|2(PC1)   (PA0)19|----------led2 
*  NC------------|3(PC0)   (PA1)18|----------led1
*  NC------------|4(PB7)   (PA2)17|------------NC
*  NC------------|5(PB6)   (PA3)16|------------NC
*  NC------------|6(PB5)   (PA4)15|------------NC
*  NC------------|7(PB4)   (PA5)14|------------NC
*  NC------------|8(PB3)   (PA6)13|------------NC
*  NC------------|9(PB2)   (PA7)12|------------NC
*  NC------------|10(PB1)  (PB0)11|------------NC
*                 ----------------   
*/
//========================================================
#include "SYSCFG.h"
//========================================================
#define  unchar     unsigned char 

#define  led1		PA1
#define  led2		PA0
 /*-------------------------------------------------
 *  函数名：POWER_INITIAL
 *	功能：  上电系统初始化
 *  输入：  无
 *  输出：  无
 --------------------------------------------------*/	
void POWER_INITIAL (void) 
{
	OSCCON = 0B01110001;	//IRCF=111=16MHz/4T=4MHz，0.25us
    OPTION = 0B00001000;    //Bit3=1 WDT，Bit[2:0]=000=WDT RATE 1:1
	INTCON = 0;  			//暂禁止所有中断
    
	PORTA  = 0B00000000;		
	TRISA  = 0B00000000;	//PA输入输出 0-输出 1-输入
							//PA0,PA1-OUT						
	PORTC  = 0B00000000; 	
	TRISC  = 0B00000000;	//PC输入输出 0-输出 1-输入  
								
	WPUA   = 0B00000000;    //PA端口上拉控制 1-开上拉 0-关上拉                         
	WPUC   = 0B00000000;    //PC端口上拉控制 1-开上拉 0-关上拉
}
 /*-------------------------------------------------
 *  函数名：DelayUs
 *  功能：  短延时函数 
 *  输入：  Time 延时时间长度 延时时长Time us
 * 	输出：  无 
 -------------------------------------------------*/
void DelayUs(unsigned char Time)
{
	unsigned char a;
	for(a=0;a<Time;a++)
	{
		NOP();
	}
}                  
/*------------------------------------------------- 
 * 	函数名：DelayMs
 * 	功能：  短延时函数--16M-4T--大概快1%左右.
 * 	输入：  Time 延时时间长度 延时时长Time ms
 * 	输出：  无 
 -------------------------------------------------*/
void DelayMs(unsigned char Time)
{
	unsigned char a,b;
	for(a=0;a<Time;a++)
	{
		for(b=0;b<5;b++)
		{
		 	DelayUs(98);      //快1%
		}
	}
}
/*------------------------------------------------- 
 * 	函数名：DelayS
 * 	功能：  短延时函数
 * 	输入：  Time 延时时间长度 延时时长Time S
 * 	返回：  无 
 -------------------------------------------------*/
void DelayS(unsigned char Time)
{
	unsigned char a,b;
	for(a=0;a<Time;a++)
	{
		for(b=0;b<10;b++)
		{
		 	DelayMs(100); 
		}
	}
}/*-------------------------------------------------
 *  函数名:  main 
 *	功能：  主函数
 *  输入：  无
 *  输出：  无
 --------------------------------------------------*/
void main(void)
{
	POWER_INITIAL();		//系统初始化
	led1 = 1;
    led2 = 1;
    DelayS(4);
    led1 = 0;
    led2 = 0;

    while(1)
	{
    	CLRWDT();  		    //清看门狗
		NOP();
     	SLEEP(); 
		NOP();
	}
}