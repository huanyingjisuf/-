//********************************************************* 
/* 文件名：TEST_60F01x_SLEEP.c
* 功能：   FT60F01x-SLEEP功能演示
* IC:      FT60F011A SOP8
* 晶振：   16M/4T                    
* 说明：   此程序为FT60F01x-SLEEP睡眠演示程序，上电之后PA0、PA1同时置高约4s，
*          然后置低，进入睡眠。测试FT60F01x的睡眠功耗： 
*
*                  FT60F011A  SOP8 
*                 ----------------
*  VDD-----------|1(VDD)    (GND)8|-----------GND     
*  NC------------|2(PA2)    (PA4)7|------------NC
*  led1----------|3(PA1)    (PA5)6|------------NC
*  NC------------|4(PA3)    (PA0)5|----------led2
*			      ----------------
*/
//*********************************************************
#include "SYSCFG.h"
//***********************宏定义****************************
#define  unchar	unsigned char 

#define  led1	PA1
#define  led2	PA0
 /*-------------------------------------------------
 * 函数名：POWER_INITIAL
 * 功能：  上电系统初始化
 * 输入：  无
 * 输出：  无
 --------------------------------------------------*/	
void POWER_INITIAL (void) 
{
	OSCCON = 0B01110000;				//IRCF=111=16MHz/4T=4MHz,0.25us                           
	INTCON = 0;  						//暂禁止所有中断
	OPTION = 0B00001000;				//Bit3=1,WDT MODE,PS=000=WDT RATE 1:1

	PORTA = 0B00000000;					
	TRISA = 0B00000000;					//PA输入输出 0-输出 1-输入
	WPUA = 0B00000000;     				//PA端口上拉控制 1-开上拉 0-关上拉
    								
	MSCKCON = 0B00000000;
	//Bit4=0,禁止LVR(60F01x O版之前)       
	//Bit4=0,LVREN使能时,开启LVR(60F01x O版及O版之后)  
    //Bit4=1,LVREN使能时,工作时开启LVR,睡眠时自动关闭LVR(60F01x O版及O版后)                                
}
/*-------------------------------------------------
 * 函数名：DelayUs
 * 功能：  短延时函数 
 * 输入：  Time 延时时间长度 延时时长Time us
 * 输出：  无 
 -------------------------------------------------*/
void DelayUs(unsigned char Time)
{
	unsigned char a;
	for(a=0;a<Time;a++)
	{
		CLRWDT();
	}
}                  
/*-------------------------------------------------
 * 函数名：DelayMs
 * 功能：  短延时函数--16M-2T--大概快1%左右.
 * 输入：  Time 延时时间长度 延时时长Time ms
 * 输出：  无 
 -------------------------------------------------*/
void DelayMs(unsigned char Time)
{
	unsigned char a,b;
	for(a=0;a<Time;a++)
	{
		for(b=0;b<5;b++)
		{
		 	DelayUs(98); 	             	//快1%
		}
	}
}
/*-------------------------------------------------
 * 函数名：DelayS
 * 功能：  短延时函数
 * 输入：  Time 延时时间长度 延时时长Time S
 * 输出：  无 
 -------------------------------------------------*/
void DelayS(unsigned char Time)
{
	unsigned char a,b;
	for(a=0;a<Time;a++)
	{
		for(b=0;b<10;b++)
		{
		 	DelayMs(100); 	
		}
	}
}
/*-------------------------------------------------
 * 函数名:  main 
 * 功能：  主函数
 * 输入：  无
 * 输出：  无
 --------------------------------------------------*/
void main()
{
	POWER_INITIAL();	//系统初始化
	led1 = 1;
	led2 = 1;
    DelayS(4);
	led1 = 0;
	led2 = 0;
	while(1)
	{
    	CLRWDT();  		//清看门狗
		NOP();
     	SLEEP(); 
		NOP();      
	}
}
