//********************************************************* 
/*  文件名：TEST_61F02x_VREG.c
*	功能：  FT61F02x-dac功能演示
*   IC:     FT61F023 SOP16
*   晶振：  16M/2T                    
*   说明：  利用稳压输出器在PA4上输出频率为16K幅值为3.6V的三角波
*			在PA5上输出3.6/2=1.8V电压
*
*                  FT61F023  SOP16 
*                 ----------------
*  VDD-----------|1(VDD)   (VSS)16|-----------GND     
*  NC------------|2(PA7)   (PA0)15|------------NC 
*  NC------------|3(PA6)   (PA1)14|------------NC
*  NC------------|4(PA5)   (PA2)13|------------NC
*  NC------------|5(PC3)   (PA3)12|------------NC
*  NC------------|6(PC2)   (PC0)11|------------NC
*  VREGP---------|7(PA4)   (PC1)10|------------NC
*  VREGN---------|8(PC5)   (PC4)09|------------NC
*			      ----------------
*/
//*********************************************************
#include "SYSCFG.h"
//***********************宏定义*****************************
#define  unchar     unsigned char 
 
volatile bit SAFlag;
volatile unchar VREGC;
/*-------------------------------------------------
 *  函数名：POWER_INITIAL
 *	功能：  上电系统初始化
 *  输入：  无
 *  输出：  无
 --------------------------------------------------*/	
void POWER_INITIAL (void) 
{ 
	OSCCON = 0B01110001; 	//IRCF=111=16MHz/2T=8MHz,0.125us
	INTCON = 0;          	//暂禁止所有中断
	PORTA = 0B00000000;
	TRISA = 0B00000000;  	//PA输入输出 0-输出 1-输入
							//PA4->输出
	PORTC = 0B00000000; 
	TRISC = 0B00000000;	 	//PC输入输出 0-输出 1-输入,PC5输出  

	WPUA = 0B00000000;   	//PA端口上拉控制 1-开上拉 0-关上拉

	WPUC = 0B00000000;   	//PC端口上拉控制 1-开上拉 0-关上拉

	OPTION = 0B00001000;	//Bit3=1,WDT MODE,PS=000=WDT RATE 1:1
    MSCKCON = 0B00000000;
    //Bit6->0,禁止PA4，PC5稳压输出
	//Bit5->0,TIMER2时钟为Fosc
	//Bit4->0,禁止LVR
    
	CMCON0 = 0B00000111; //关闭比较器，CxIN为数字IO口
}
/*----------------------------------------------------
 *	函数名称：DelayUs
 *	功能：   短延时函数 --16M-2T--大概快1%左右.
 *	输入参数：Time 延时时间长度 延时时长Time Us
 *	返回参数：无 
 ----------------------------------------------------*/
void DelayUs(unsigned char Time)
{
	unsigned char a;
	for(a=0;a<Time;a++)
	{
		NOP();
	}
}                  
/*----------------------------------------------------
 *	函数名称：DelayMs
 *	功能：    短延时函数 快1%
 *	输入参数：Time 延时时间长度 延时时长Time ms
 *	返回参数：无 
 ----------------------------------------------------*/
void DelayMs(unsigned char Time)
{
	unsigned char a,b;
	for(a=0;a<Time;a++)
	{
		for(b=0;b<5;b++)
		{
		 	DelayUs(197);
		}
	}
}
/*-------------------------------------------------
 *  函数名：VREG_INITIAL
 *	功能：  稳压器输出初始化
 *  设置稳压器输出电压1=VREG*(VREGHB+1)/32
 *					  =3.6*(31+1)/32 =3.6V
 *		稳压器输出电压2=VREG*(VREGLB+1)/32
 *					  =3.6*(15+1)/32 = 1.8V
 --------------------------------------------------*/	
void VREG_INITIAL(void) 
{
	VREG_OE = 0;
	VCON1 = 0B00111111; //VREG = 3.6V
	//Bit[6:5] VREGM[1:0]-D稳压器电压(VREG)选择位 00-2.4V 01-3.6V 10-4.8V 11-5.3V
	//Bit[4:0] VREGHB[4:0] PA4输出电压设置 
	
	VCON2 = 0B00001111;
	//Bit[4:0] VREGLB[4:0] PC5输出电压设置 
	//VOUT = VREG*(VREGLB+1)/32	
		
	VREG_OE = 1;        //稳压器输出使能
}
/*-------------------------------------------------
 *  函数名:  main 
 *	功能：  主函数
 *  输入：  无
 *  输出：  无
 --------------------------------------------------*/
void main()
{
	POWER_INITIAL();	        //系统初始化
	VREG_INITIAL();		        //输出稳压器初始化
	SAFlag = 1;
	while(1)
	{
		if(SAFlag == 1)         // 产生三角波
		{
			VREGC++;			//输出电压增加
			VCON1 &= 0B11100000;
       		VCON1 |= VREGC;
			if(VREGC >= 31)
			{ 
				 SAFlag = 0;
			}
		}
		else	 
		{
			VREGC--;	        //输出电压减小
			VCON1 &= 0B11100000;
       		VCON1 |= VREGC;
			if(VREGC == 0)
			{
				SAFlag = 1;
			}
		}
		DelayMs(1);             //1ms
	}
}
