//********************************************************* 
/* 文件名：TEST_61F02x_MSCK.C
* 功能：   FT61F02x-IO快时钟测量慢时钟功能演示
* IC:      FT61F023_IO SOP16
* 晶振：   16M/2T                    
* 说明：   程序中读取快时钟测量慢时钟数据
*
*                  FT61F023  SOP16 
*                 ----------------
*  VDD-----------|1(VDD)   (VSS)16|-----------GND     
*  NC------------|2(PA7)   (PA0)15|------------NC 
*  NC------------|3(PA6)   (PA1)14|------------NC
*  NC------------|4(PA5)   (PA2)13|------------NC
*  NC------------|5(PC3)   (PA3)12|------------NC
*  NC------------|6(PC2)   (PC0)11|------------NC
*  NC------------|7(PA4)   (PC1)10|------------NC
*  NC------------|8(PC5)   (PC4)09|------------NC
*			      ----------------
*/
//*********************************************************
#include "SYSCFG.h"
//**********************宏定义*****************************
#define	 unint	unsigned int
 
volatile unint	TestBuff;
/*-------------------------------------------------
* 函数名：POWER_INITIAL
* 功能：  上电系统初始化
* 输入：  无
* 输出：  无
 --------------------------------------------------*/	
void POWER_INITIAL (void) 
{
    OSCCON = 0B01110001;			//IRCF=111=16MHz/2=8MHz,0.125us
	INTCON = 0;  					//暂禁止所有中断
	PORTA = 0B00000000;		
	TRISA = 0B00000000;				//PA输入输出  1-输入 0-输出
	PORTC = 0B00000000; 	
	TRISC = 0B00000000;				//PC输入输出  1-输入 0-输出
	WPUA = 0;          				//禁止所有PA口上拉
	WPUC = 0;       				//禁止所有PC口上拉
    
	OPTION = 0B00001000;			//Bit3=1,WDT MODE,PS=000=WDT RATE 1:1
    MSCKCON = 0B00000000;
    //Bit6->0,禁止PA4，PC5稳压输出
	//Bit5->0,TIMER2时钟为Fosc
	//Bit4->0,禁止LVR       
	CMCON0 = 0B00000111; 			//关闭比较器，CxIN为数字IO口
}
/*----------------------------------------------------
* 函数名：DelayUs
* 功能：  短延时函数 --16M-2T--大概快1%左右.
* 输入：  Time 延时时间长度 延时时长Time μs
* 输出：  无
 ----------------------------------------------------*/
void DelayUs(unsigned char Time)
{
	unsigned char a;
	for(a=0;a<Time;a++)
	{
		NOP();
	}
}                  
/*----------------------------------------------------
* 函数名： DelayMs
* 功能：   短延时函数
* 输入：   Time 延时时间长度 延时时长Time ms
* 输出：   无
 ----------------------------------------------------*/
void DelayMs(unsigned char Time)
{
	unsigned char a,b;
	for(a=0;a<Time;a++)
	{
		for(b=0;b<5;b++)
		{
		 	DelayUs(197); 			//快1%
		}
	}
}
/*-------------------------------------------------
* 函数名：SlowTimeTest
* 功能：  快时钟测量慢时钟
* 输入：  无
* 输出：  慢时钟时钟测量值TestTime
		  不开平均模式慢时钟频率=16M/TestTime(2T)
		  开平均模式慢时钟频率=16M/TestTime/4(2T)
 --------------------------------------------------*/
unint SlowTimeTest()
{
	unint TestTime;
	OSCCON = 0B01110001;			//IRCF=111=16MHz/2=8MHz,0.125us
	TMR2ON = 1;						//开定时器2
	CKMEAIF = 0;					//清标志位
	CKMAVG = 0;						//关闭平均模式 
									//注:打开平均模式输出数据为四个周期的时钟数(单周期*4)
	CKCNTI = 1; 					//使能快时钟测量位,开始测量
	while(!CKMEAIF);
	CKMEAIF = 0;
	TestTime = SOSCPRH << 8;
	TestTime = TestTime + SOSCPRL;
	return TestTime;
}
/*-------------------------------------------------
* 函数名：main
* 功能：  主函数
* 输入：  无
* 输出：  无
 --------------------------------------------------*/
void main()
{
	POWER_INITIAL();			    //系统初始化
	while(1)
	{
		TestBuff = SlowTimeTest();  //时钟测量值
									//32768该数值≈488(不开平均模式-单周期)
		NOP();
		NOP();
		NOP();
		DelayMs(200); 			    //延时200ms
	}
}