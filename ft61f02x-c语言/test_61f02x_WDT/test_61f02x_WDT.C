//********************************************************* 
/* 文件名：TEST_61F02x_WDT.c
* 功能：   FT61F02x-WDT功能演示
* IC：     FT61F023_WDT SOP16
* 晶振：   16M/2T                    
* 说明：   程序中开启看门狗并将看门狗时间设置为32ms
*		    a. 主函数先在DemoPortOut脚输出一个高3ms低3ms的信号，
*		    b. 然后循环输出高1ms低1ms，500HZ的信号。
*		    如果不在主程序中清看门狗，则每隔32ms单片机复位后，会重复输出a+b信号；
*		    如果在主函数中清看门狗，则一直输出b信号
*
*                  FT61F023  SOP16 
*                 ----------------
*  VDD-----------|1(VDD)   (VSS)16|-----------GND     
*  NC------------|2(PA7)   (PA0)15|------------NC 
*  NC------------|3(PA6)   (PA1)14|------------NC
*  NC------------|4(PA5)   (PA2)13|------------NC
*  NC------------|5(PC3)   (PA3)12|---DemoPortOut
*  NC------------|6(PC2)   (PC0)11|------------NC
*  NC------------|7(PA4)   (PC1)10|------------NC
*  NC------------|8(PC5)   (PC4)09|------------NC
*			      ----------------
*/
//*********************************************************
#include "SYSCFG.h"
//***********************宏定义****************************
#define	DemoPortOut	PA3
/*-------------------------------------------------
* 函数名：POWER_INITIAL
* 功能：  上电系统初始化
* 输入：  无
* 输出：  无
 --------------------------------------------------*/	
void POWER_INITIAL (void) 
{	 
	OSCCON = 0B01110001;	//IRCF=111=16MHz/2=8MHz,0.125us
	INTCON = 0;  			//暂禁止所有中断
    
	PORTA = 0B00000000;		
	TRISA = 0B00000000;		//PA输入输出 0-输出 1-输入
							//PA3->输出
	PORTC = 0B00000000; 	
	TRISC = 0B00000000;		//PC输入输出 0-输出 1-输入  
	WPUA = 0B00000000;     	//PA端口上拉控制 1-开上拉 0-关上拉
	WPUC = 0B00000000;     	//PC端口上拉控制 1-开上拉 0-关上拉

	OPTION = 0B00001000;	//Bit3=1,WDT MODE,PS=000=WDT预分频比1:1
    MSCKCON = 0B00000000;
    //Bit6->0,禁止PA4，PC5稳压输出
	//Bit5->0,TIMER2时钟为Fosc
	//Bit4->0,禁止LVR       
	CMCON0 = 0B00000111; 	//关闭比较器，CxIN为数字IO口
}
/*----------------------------------------------------
 * 函数名：DelayUs
 * 功能：  短延时函数 --16M-2T--大概快1%左右.
 * 输入：  Time 延时时间长度 延时时长Timeμs
 * 输出：  无 
 ----------------------------------------------------*/
void DelayUs(unsigned char Time)
{
	unsigned char a;
	for(a=0;a<Time;a++)
	{
		NOP();
	}
}                  
/*----------------------------------------------------
 * 函数名：DelayMs
 * 功能：  短延时函数 快1%
 * 输入：  Time 延时时间长度 延时时长Time ms
 * 输出：  无 
 ----------------------------------------------------*/
void DelayMs(unsigned char Time)
{
	unsigned char a,b;
	for(a=0;a<Time;a++)
	{
		for(b=0;b<5;b++)
		{
		 	DelayUs(197); 		
		}
	}
}
/*-------------------------------------------------
* 函数名：WDT_INITIAL
* 功能：  初始化设置看门狗1S时间复位
* 设置看门狗周期=(1/32000)*16位预分频值*8位预分频值
* 				=(1/32000)*1024*1=32ms
 -------------------------------------------------*/
void WDT_INITIAL (void) 
{
    //CLRWDT();				//清看门狗
	PSA=1;     				//时钟分频分给WDT
	WDTCON = 0B00001011;
    //Bit[4:1]: WDTPS=0101-WDT预分频比1:1024
    //Bit0:		SWDTEN=1-WDT使能
}
/*-------------------------------------------------
* 函数名：main 
* 功能：  主函数
* 输入：  无
* 输出：  无
 --------------------------------------------------*/
void main()
{
	POWER_INITIAL();		//系统初始化
	WDT_INITIAL();			//看门狗初始化
	DemoPortOut = 1; 		
	DelayMs(3);     		//3ms
	DemoPortOut = 0;
	DelayMs(3); 			//3ms
	while(1)
	{	
	 	//CLRWDT(); 			//清看门狗
		DemoPortOut = 1; 	
		DelayMs(1);     	//1ms
		DemoPortOut = 0; 
		DelayMs(1); 		//1ms
	}
}
