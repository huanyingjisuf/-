//********************************************************* 
/* 文件名：TEST_61F02x_Timer2.c
* 功能：   FT61F02x-Timer2功能演示
* IC:      FT61F023 SOP16
* 晶振：   16M/2T                    
* 说明：   当DemoPortIn悬空或者高电平时,
*		   DemoPortOut输出5kHz占空比50%的波形-Timer2实现
*		   当DemoPortIn接地时,DemoPortOut输出高电平.关定时器
*
*                 FT61F023  SOP16 
*                 ----------------
*  VDD-----------|1(VDD)   (VSS)16|-----------GND     
*  NC------------|2(PA7)   (PA0)15|------------NC 
*  NC------------|3(PA6)   (PA1)14|------------NC
*  NC------------|4(PA5)   (PA2)13|------------NC
*  DemoPortIn----|5(PC3)   (PA3)12|---DemoPortOut
*  NC------------|6(PC2)   (PC0)11|------------NC
*  NC------------|7(PA4)   (PC1)10|------------NC
*  NC------------|8(PC5)   (PC4)09|------------NC
*			      ----------------
*/ 
//*********************************************************
#include "SYSCFG.h"
//***********************宏定义****************************
#define  DemoPortOut	PA3   
#define  DemoPortIn		PC3
/*-------------------------------------------------
* 函数名：interrupt ISR
* 功能：  定时器2的中断处理
* 输入：  无
* 输出：  无
 --------------------------------------------------*/
void interrupt ISR(void)           
{ 
	if(TMR2IE && TMR2IF)		//100us中断一次
	{
		TMR2IF = 0;
		DemoPortOut = ~DemoPortOut;//翻转电平
	} 
} 
/*-------------------------------------------------
* 函数名：POWER_INITIAL
* 功能：  上电系统初始化
* 输入：  无
* 输出：  无
 --------------------------------------------------*/	
void POWER_INITIAL (void) 
{
	OPTION = 0B00001000;	//Bit3=1,WDT MODE,PS=000=WDT RATE 1:1
    INTCON = 0;             //暂禁止所有中断
    OSCCON = 0B01110001;	//IRCF=111=16MHz/2T=8MHz,0.125us
    
	PORTA = 0B00000000;
	TRISA = 0B00000000;	    //PA输入输出 0-输出 1-输入
						    //PA3->输出
	PORTC = 0B00000000; 
	TRISC = 0B00001000;	    //PC输入输出 0-输出 1-输入
						    //PC3-输入     
	WPUA = 0B00000000;      //PA端口上拉控制 1-开上拉 0-关上拉
	WPUC = 0B00001000;      //PC端口上拉控制 1-开上拉 0-关上拉
    
	OPTION = 0B00001000;	//Bit3=1,WDT MODE,PS=000=WDT RATE 1:1
    MSCKCON = 0B00000000;
    //Bit6->0,禁止PA4，PC5稳压输出
	//Bit5->0,TIMER2时钟为Fosc
	//Bit4->0,禁止LVR
    
	CMCON0 = 0B00000111;    //关闭比较器，CxIN为数字IO口
}
/*-------------------------------------------------
* 函数名：TIMER2_INITIAL
* 功能：      初始化设置定时器2
* 设置定时时长=(1/系统时钟频率)*指令周期*预分频值*后分频值*PR2
*			  =1/16000000*2*4*1*200=100us
 -------------------------------------------------*/
void TIMER2_INITIAL (void) 
{
	T2CON = 0B00000001;
	//Bit[6:3]=0000,T2后分频比1:1
    //Bit[1:0]=01,  T2时钟预分频比 1:4
    
	TMR2 = 0;           	//TMR2赋初值
	PR2 = 200;          	//赋值PR2
    
	TMR2IF = 0;         	//清TIMER2中断标志
	TMR2IE = 1;         	//使能TIMER2的中断
	TMR2ON = 1;         	//使能TIMER2启动
	PEIE = 1;           	//使能外设中断
	GIE = 1;            	//使能全局中断
}
/*-------------------------------------------------
* 函数名：main 
* 功能：  主函数
* 输入：  无
* 输出：  无
 --------------------------------------------------*/
void main()
{
	POWER_INITIAL();		//系统初始化
	TIMER2_INITIAL();		//初始化T2
	
	while(1)
	{ 
		if(DemoPortIn == 1) //判断输入是否为高电平 
		{
			TMR2IE = 1;     //开定时器2
		}
		else
		{
			TMR2IE = 0;     //关定时器2
			DemoPortOut = 1;
		}  
	}
}
