//********************************************************* 
/* 文件名: TEST_61F02x_INT.c
* 功能：   FT61F02x-INT功能演示
* IC:      FT61F023 SOP16
* 晶振：   16M/2T                    
* 说明：   程序中DemoPortOut(PA3)输出100帧50Hz的占空比为50%的方波后, 
*          MCU进入睡眠, 等待外部中断的发生；
*		   当外部中断触发后，重复以上流程;
*
*                 FT61F023  SOP16 
*                ----------------
* VDD-----------|1(VDD)   (VSS)16|-----------GND     
* NC------------|2(PA7)   (PA0)15|------------NC 
* NC------------|3(PA6)   (PA1)14|------------NC
* NC------------|4(PA5)   (PA2)13|------------NC
* NC------------|5(PC3)   (PA3)12|---DemoPortOut
* NC------------|6(PC2)   (PC0)11|------------NC
* NC------------|7(PA4)   (PC1)10|-----------INT<--中断IN
* NC------------|8(PC5)   (PC4)09|------------NC
*			     ----------------
*/
//*********************************************************
#include "SYSCFG.h"
//***********************宏定义****************************
#define  unchar			unsigned char 
#define  DemoPortOut	PA3   

unchar	 FCount;
/*-------------------------------------------------

* 函数名：interrupt ISR
* 功能：  PC1中断处理函数
* 输入：  无
* 输出：  无

 --------------------------------------------------*/
void interrupt ISR(void)    
{ 
	if(INTE && INTF)		
	{                   	
		INTF = 0;  			//清PC1 INT 标志位
		INTE = 0;  			//暂先禁止INT中断
	}
} 
/*----------------------------------------------------
* 函数名：POWER_INITIAL
* 功能：  上电系统初始化
* 输入：  无
* 输出：  无
 ----------------------------------------------------*/	
void POWER_INITIAL (void) 
{ 
	OSCCON = 0B01110001;	//IRCF=111=16MHz/2=8MHz,0.125us
	INTCON = 0;  			//暂禁止所有中断
	PORTA = 0B00000000;		
	TRISA = 0B00000000;		//PA输入输出 0-输出 1-输入
	PORTC = 0B00000000; 	
	TRISC = 0B00000010;		//PC输入输出 0-输出 1-输入
							//PC1->输入
	WPUA = 0B00000000;     	//PA端口上拉控制 1-开上拉 0-关上拉
	WPUC = 0B00000000;    	//PC端口上拉控制 1-开上拉 0-关上拉

	OPTION = 0B00001000;	//Bit3=1,WDT MODE,PS=000=WDT RATE 1:1
	MSCKCON = 0B00000000;
    //Bit6->0,禁止PA4，PC5稳压输出
	//Bit5->0,TIMER2时钟为Fosc
	//Bit4->0,禁止LVR       
	CMCON0 = 0B00000111;	//关闭比较器，CxIN为数字IO口
}
/*---------------------------------------------------- 
* 函数名称：DelayUs
* 功能：    短延时函数 --16M-2T--大概快1%左右.
* 输入参数：Time 延时时间长度 延时时长Time Us
* 返回参数：无 
 ----------------------------------------------------*/
void DelayUs(unsigned char Time)
{
	unsigned char a;
	for(a=0;a<Time;a++)
	{
		NOP();
	}
}                  
/*----------------------------------------------------
* 函数名称：DelayMs
* 功能：    短延时函数
* 输入参数：Time 延时时间长度 延时时长Time ms
* 返回参数：无 
 ----------------------------------------------------*/
void DelayMs(unsigned char Time)
{
	unsigned char a,b;
	for(a=0;a<Time;a++)
	{
		for(b=0;b<5;b++)
		{
		 	DelayUs(197);	//快1%
		}
	}
}
/*-------------------------------------------------
* 函数名: INT_INITIAL 
* 功能：  中断初始化函数
* 输入：  无
* 输出：  无
 --------------------------------------------------*/
void INT_INITIAL(void)
{
	TRISC1 = 1; 			//SET PC1 INPUT
	ANSEL = 0B00000000;		//关闭中断引脚模拟输入功能

	INTEDG =1; 				//OPTION,INTEDG=1; PC1 INT为上升沿触发 
	INTF =0;   				//清PC1 INT中断标志位
	INTE =1;   				//使能PC1 INT中断
}
/*-------------------------------------------------
* 函数名：main 
* 功能：  主函数
* 输入：  无
* 输出：  无
 --------------------------------------------------*/
void main ()
{
	POWER_INITIAL();						//系统初始化
	 
	while(1)
	{
		for(FCount=0;FCount<100;FCount++)	//输出100次波形	
		{
			DemoPortOut = 1; 				
			DelayMs(10);  					//10ms 
			DemoPortOut = 0;
			DelayMs(10); 
		}
		INT_INITIAL();						//初始化外部中断
		GIE = 1;							//开总中断
		SLEEP(); 							//睡眠
	}
}



