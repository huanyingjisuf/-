//********************************************************* 
/* 文件名 TEST_61F02x_SLEEP.c
* 功能：  FT61F02x-SLEEP功能演示
* IC：    FT61F023 SOP16
* 晶振：  16M/4T                    
* 说明：  此程序为FT61F02x-SLEEP睡眠演示程序，上电之后led1 led2同时亮一下熄灭，
*         进入睡眠，测试FT61F02x的睡眠功耗  
*
*                  FT61F023  SOP16 
*                 ----------------
*  VDD-----------|1(VDD)   (VSS)16|-----------GND     
*  NC------------|2(PA7)   (PA0)15|----------led2 
*  NC------------|3(PA6)   (PA1)14|----------led1
*  NC------------|4(PA5)   (PA2)13|------------NC
*  NC------------|5(PC3)   (PA3)12|------------NC
*  NC------------|6(PC2)   (PC0)11|------------NC
*  NC------------|7(PA4)   (PC1)10|------------NC
*  NC------------|8(PC5)   (PC4)09|------------NC
*			      ----------------
*/
//*********************************************************
#include "SYSCFG.h"
//***********************宏定义****************************
#define  led1	RA1
#define  led2	RA0
 /*-------------------------------------------------
* 函数名：POWER_INITIAL
* 功能：  上电系统初始化
* 输入：  无
* 输出：  无
 --------------------------------------------------*/

void POWER_INITIAL (void) 
{
	OSCCON = 0B01110001;			//IRCF=111=16MHz/4T=4MHz,0.25us
	INTCON = 0;  					//暂禁止所有中断
    
	PORTA = 0B00000000;		
	TRISA = 0B00000000;				//PA输入输出 0-输出 1-输入  
  	PORTC = 0B00000000; 	
	TRISC = 0B00000000;		        //PC输入输出 0-输出 1-输入  
    WPUA = 0B00000000;     			//PA端口上拉控制 1-开上拉 0-关上拉
    WPUC = 0B00000000;     			//PC端口上拉控制 1-开上拉 0-关上拉

	ANSEL = 0B00000000;
	OPTION = 0B00001000;			//Bit3=1,WDT MODE,PS=000=WDT RATE 1:1
	MSCKCON = 0B00000000;
    //Bit6->0,禁止PA4，PC5稳压输出
	//Bit5->0,TIMER2时钟为Fosc
	//Bit4->0,禁止LVR       
	CMCON0 = 0B00000111; 			//关闭比较器，CxIN为数字IO口
}
/*-------------------------------------------------
* 函数名：DelayUs
* 功能：  短延时函数 --16M-2T--大概快1%左右.
* 输入：  Time 延时时间长度 延时时长Time us
* 输出：  无 
 -------------------------------------------------*/
void DelayUs(unsigned char Time)
{
	unsigned char a;
	for(a=0;a<Time;a++)
	{
		NOP();
	}
}                  
/*-------------------------------------------------
* 函数名：DelayMs
* 功能：  短延时函数，快1%
* 输入：  Time 延时时间长度 延时时长Time ms
* 输出：  无 
 -------------------------------------------------*/
void DelayMs(unsigned char Time)
{
	unsigned char a,b;
	for(a=0;a<Time;a++)
	{
		for(b=0;b<5;b++)
		{
		 	DelayUs(98);
		}
	}
}
/*-------------------------------------------------
* 函数名：DelayS
* 功能：  短延时函数
* 输入：  Time 延时时间长度 延时时长TimeS
* 输出：  无 
 -------------------------------------------------*/
void DelayS(unsigned char Time)
{
	unsigned char a,b;
	for(a=0;a<Time;a++)
	{
		for(b=0;b<10;b++)
		{
		 	DelayMs(100); 	
		}
	}
}
/*-------------------------------------------------
* 函数名：main 
* 功能：  主函数
* 输入：  无
* 输出：  无
 --------------------------------------------------*/
void main()
{
	POWER_INITIAL();				//系统初始化
	led1 = 1;
	led2 = 1;
    DelayS(4);
	led1 = 0;
	led2 = 0;
	while(1)
	{
		NOP();
     	SLEEP(); 
	}
}
	