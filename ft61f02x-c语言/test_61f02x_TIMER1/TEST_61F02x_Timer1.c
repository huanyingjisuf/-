//********************************************************* 
/* 文件名：TEST_61F02x_Timer1.c
* 功能：   FT61F02x-Timer1功能演示
* IC:      FT61F023 SOP16
* 晶振：   16M/2T                    
* 说明：   当DemoPortIn悬空或者高电平时,
*		   DemoPortOut输出1kHz占空比50%的波形-Timer1实现
*		   当DemoPortIn接地时,DemoPortOut输出高电平.关定时器中断
*
*                  FT61F023  SOP16 
*                 ----------------
*  VDD-----------|1(VDD)   (VSS)16|-----------GND     
*  NC------------|2(PA7)   (PA0)15|------------NC 
*  NC------------|3(PA6)   (PA1)14|------------NC
*  NC------------|4(PA5)   (PA2)13|------------NC
*  DemoPortIn----|5(PC3)   (PA3)12|---DemoPortOut
*  NC------------|6(PC2)   (PC0)11|------------NC
*  NC------------|7(PA4)   (PC1)10|------------NC
*  NC------------|8(PC5)   (PC4)09|------------NC
*			      ----------------
*/
//*********************************************************
#include "SYSCFG.h"
//***********************宏定义****************************
#define  DemoPortOut	PA3   
#define  DemoPortIn		PC3
/*-------------------------------------------------
* 函数名：interrupt ISR
* 功能：  定时器1的中断处理
* 设置Timer1定时时长=(1/系统时钟周期)*指令周期*预分频值*TMR1H:TMR1L
* 		   			=(1/16000000)*2*1*4000=500us
 --------------------------------------------------*/
void interrupt ISR(void)           
{ 
	 if(TMR1IF)
	{
		TMR1IF = 0;
		TMR1L = 0X60;  		        //定时500us=>TMR1=4000*0.125us=500us
		                            //初值=65536-4000=61536=>0XF060
		TMR1H = 0XF0;  		        //赋初值=>TMR1H=0XF0;TMR1L=0X60    
		DemoPortOut = ~DemoPortOut; //翻转电平
	} 
} 
/*-------------------------------------------------
* 函数名：POWER_INITIAL
* 功能：  上电系统初始化
* 输入：  无
* 输出：  无
 --------------------------------------------------*/	
void POWER_INITIAL (void) 
{
	OSCCON = 0B01110001;	//IRCF=111=16MHz/2T=8MHz,0.125us
	INTCON = 0;  			//暂禁止所有中断
	PORTA = 0B00000000;		
	TRISA = 0B00000000;		//PA输入输出 0-输出 1-输入
							//PA3->输出						
	PORTC = 0B00000000; 	
	TRISC = 0B00001000;		//PC输入输出 0-输出 1-输入
							//PC3->输入						
	WPUA = 0B00000000;     	//PA端口上拉控制 1-开上拉 0-关上拉
	WPUC = 0B00001000;     	//PC端口上拉控制 1-开上拉 0-关上拉

	OPTION = 0B00001000;	//Bit3=1,WDT MODE,PS=000=WDT RATE 1:1
	MSCKCON = 0B00000000;
	//Bit6->0,禁止PA4，PC5稳压输出
	//Bit5->0,TIMER2时钟为Fosc
	//Bit4->0,禁止LVR 
	CMCON0 = 0B00000111; 	//关闭比较器，CxIN为数字IO口
}
/*-------------------------------------------------
* 函数名：TIMER1_INITIAL
* 功能：  初始化设置定时器1 
* 设置定时时长=(1/系统时钟周期)*指令周期*预分频值*TMR1H:TMR1L
* 			  =(1/16000000)*2*1*4000=500us
 -------------------------------------------------*/
void TIMER1_INITIAL (void) 
{
	//需要在中断里重新赋初始值
	T1CON = 0B00000000;
    //Bit[5:4]=00,T2时钟分频 1:1
	//Bit1=0,T1时钟源选择内部时钟
	TMR1L = 0X60;  			//TMR1低八位赋初始值
	TMR1H = 0XF0;  			//TMR1高八位赋初始值
 
	TMR1IE = 1;				//使能TMER1的中断
	TMR1ON = 1;				//使能TMER1启动
	PEIE=1;    				//使能外设中断
	GIE = 1;   				//使能全局中断
}
/*-------------------------------------------------
* 函数名：main 
* 功能：  主函数
* 输入：  无
* 输出：  无
 --------------------------------------------------*/
void main()
{
	POWER_INITIAL();		//系统初始化
	TIMER1_INITIAL();  		//初始化T1 
	 
	while(1)
	{ 
		if(DemoPortIn == 1) //判断输入是否为高电平 
		{
			TMR1IE = 1; 	//开定时器1中断
		}
		else
		{
			TMR1IE = 0; 	//关定时器1中断
			DemoPortOut = 1;
		}  
	}
}