#ifndef _RTC_C_
#define _RTC_C_
/*********************************************************************************************************************/
#include "include/ca51f_config.h"		
#include "include/ca51f3sfr.h"
#include "include/ca51f3xsfr.h"
#include "include/gpiodef_f3.h"
#include "include/system_clock.h"

#include "include/uart.h"
#include "include/delay.h"
#include "include/rtc.h"
#include <intrins.h>
/*********************************************************************************************************************/
/***********************************************************************************
函数名：		RTC_WriteSecond
功能说明： 	RTC写入秒值
输入参数： 	second		秒值
返回值：		无
***********************************************************************************/	
void RTC_WriteSecond(unsigned char second) //second = 0~59
{
	if(second > 59) return;
	RTCON |= RTCWE(1);
	RTCS = second;
	Delay_50us(1);
	RTCON &= ~RTCWE(1);	 	
}
/***********************************************************************************/



/***********************************************************************************
函数名：		RTC_WriteMinute
功能说明： 	RTC写入分值
输入参数： 	minute		分值
返回值：		无
***********************************************************************************/	
void RTC_WriteMinute(unsigned char minute) //minute = 0~59
{
	if(minute > 59) return;
	RTCON |= RTCWE(1);
	RTCM = minute;
	Delay_50us(1);
	RTCON &= ~RTCWE(1);
}
/***********************************************************************************/



/***********************************************************************************
函数名：		RTC_WriteHour
功能说明： 	RTC写入小时
输入参数： 	hour		小时值
返回值：		无
***********************************************************************************/
void RTC_WriteHour(unsigned char hour)	//hour = 0~23
{
	if(hour > 23) return;
	RTCON |= RTCWE(1);
	RTCH = (RTCH&0xE0)|hour;
	Delay_50us(1);
	RTCON &= ~RTCWE(1);	 	
}
/***********************************************************************************/



/***********************************************************************************
函数名：		RTC_WriteWeek
功能说明： 	RTC写入星期
输入参数： 	week		星期值
返回值：		无
***********************************************************************************/
void RTC_WriteWeek(unsigned char week) //hour = 1~7代表星期一~星期天, 如果week = 0， 表示关闭星期计数功能
{
	if(week > 7) return;
	RTCON |= RTCWE(1);
	RTCH = (RTCH&0x1F)|(week<<5);
	Delay_50us(1);
	RTCON &= ~RTCWE(1);	 	
}
/***********************************************************************************/

/*********************************************************************************************************************/
#endif