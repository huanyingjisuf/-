
#ifndef _MAIN_C_
#define _MAIN_C_
/*********************************************************************************************************************/
#include "include/ca51f_config.h"		
#include "include/ca51f3sfr.h"
#include "include/ca51f3xsfr.h"
#include "include/gpiodef_f3.h"
#include "include/system_clock.h"

#include "include/uart.h"
#include "include/delay.h"
#include <intrins.h>
/*********************************************************************************************************************
	本例程以P00为例，设置P00为不同模式，所有IO用法与P00相同。
*********************************************************************************************************************/
void main(void)
{
#if (SYSCLK_SRC == PLL)
	Sys_Clk_Set_PLL(PLL_Multiple);	//设置系统时钟为PLL，PLL_Multiple为倍频倍数
#endif
	
#ifdef UART0_EN
	Uart0_Initial(UART0_BAUTRATE);	//初始化UART0
#endif
	
#ifdef UART1_EN
	Uart1_Initial(UART1_BAUTRATE);	//初始化UART1
#endif

	EA = 1;													//开全局中断

#ifdef PRINT_EN
	uart_printf("GPIO Demo Code\n");
#endif

/**************************************************************************************************/
	P00F = OUTPUT;			//P00设置为推挽输出模式
	while(1)
	{
		P00 = ~P00;			//P00取反输出
	}
/***********************************************************************************/		


/***********************************************************************************/		
	P00F = INPUT;			//P00设置为输入模式
	while(1)
	{
		if(P00)
		{
#ifdef PRINT_EN
			uart_printf("P00 Input High!\n");
#endif
		}
		else
		{
#ifdef PRINT_EN
			uart_printf("P00 Input Low!\n");
#endif
		}
	}
/***********************************************************************************/	
	
	
	

/***********************************************************************************/	
	P00F = OUTPUT;					//P00设置为推挽输出模式
	P00C |= 0x80;					//P00使能高灌电流模式
/***********************************************************************************/	

	
/***********************************************************************************/	
	P00F = INPUT|PU_EN;				//P00设置为输入模式并使能上拉电阻
	P00C |= 0x20;					//上拉电阻选择为强上拉
// 	P00C &= ~0x20;					//上拉电阻选择为弱上拉
/***********************************************************************************/



/***********************************************************************************/	
	P00F = INPUT|PD_EN;				//P00设置为输入模式并使能下拉电阻
	P00C |= 0x10;					//下拉电阻选择为强下拉
// 	P00C &= ~0x10;					//下拉电阻选择为弱下拉
/***********************************************************************************/	


/***********************************************************************************/	
	P00F = P00_COM0_SETTING;		//P00设置为COM引脚功能
/***********************************************************************************/	
	
	while(1)
	{

	}
}
#endif
