//********************************************************* 
/* 文件名: TEST_62F08x_WDT.c
* 功能：   FT62F08x-WDT功能演示
* IC:      FT62F088 LQFP32
* 内部：   16M/2T
* empno:   500                                
* 说明：   程序中开启看门狗并将看门狗时间设置为32ms
*		   a. 主函数先在DemoPortOut脚输出一个高3ms低3ms的信号，
*		   b. 然后循环输出高1ms低1ms，500HZ的信号。
*		   如果不在主程序中清看门狗，则每隔32ms单片机复位后，会重复输出a+b信号；
*		   如果在主函数中清看门狗，则一直输出b信号
*
*   参考原理图 TEST_62F08x_sch.pdf
*/
//*********************************************************
#include "SYSCFG.h"
//***********************宏定义****************************
#define  unchar     unsigned char 
#define  unint      unsigned int
#define  unlong     unsigned long

#define  DemoPortOut	PB3   
/*-------------------------------------------------
 * 函数名：interrupt ISR
 * 功能：  中断处理，包括定时器0中断和外部中断
 * 输入：  无
 * 输出：  无
 --------------------------------------------------*/
void interrupt ISR(void)            	
{ 

}
/*-------------------------------------------------
 * 函数名：POWER_INITIAL
 * 功能：  上电系统初始化
 * 输入：  无
 * 输出：  无
 --------------------------------------------------*/	
void POWER_INITIAL (void) 
{
	OSCCON = 0B01110001;	//IRCF=111=16MHz
	INTCON = 0;  			//暂禁止所有中断
    
	PORTA = 0B00000000;		
	TRISA = 0B00000000;		//PA输入输出 0-输出 1-输入
	PORTB = 0B00000000;		
	TRISB = 0B00000000;		//PB输入输出 0-输出 1-输入	PB3-OUT					
	PORTC = 0B00000000; 	
	TRISC = 0B00000000;		//PC输入输出 0-输出 1-输入  	
    PORTD = 0B00000000;		
	TRISD = 0B00000000;		//PD输入输出 0-输出 1-输入
	
	WPUA = 0B00000000;     	//PA端口上拉控制 1-开上拉 0-关上拉
	WPUB = 0B00000000;     	//PB端口上拉控制 1-开上拉 0-关上拉
	WPUC = 0B00000000;     	//PC端口上拉控制 1-开上拉 0-关上拉
	WPUD = 0B00000000;     	//PD端口上拉控制 1-开上拉 0-关上拉
    
    WPDA = 0B00000000;     	//PA端口下拉控制 1-开下拉 0-关下拉
	WPDB = 0B00000000;     	//PB端口下拉控制 1-开下拉 0-关下拉
	WPDC = 0B00000000;     	//PC端口下拉控制 1-开下拉 0-关下拉
	WPDD = 0B00000000;     	//PD端口下拉控制 1-开下拉 0-关下拉
    
    PSRC0 = 0B11111111;  	//PORTA,PORTB源电流设置最大
    PSRC1 = 0B11111111;    	//PORTC,PORTD源电流设置最大    
    
    PSINK0 = 0B11111111;  	//PORTA灌电流设置最大 0:最小，1:最大
    PSINK1 = 0B11111111; 	//PORTB灌电流设置最大 0:最小，1:最大
    PSINK2 = 0B11111111;	//PORTC灌电流设置最大 0:最小，1:最大
    PSINK3 = 0B11111111;	//PORTD灌电流设置最大 0:最小，1:最大
	
    ANSELA = 0B00000000;    //全为数字管脚
}
/*------------------------------------------------- 
 * 函数名：DelayUs
 * 功能：  短延时函数 --16M-2T--大概快1%左右.
 * 输入：  Time延时时间长度 延时时长Time Us
 * 输出： 无 
 -------------------------------------------------*/
void DelayUs(unsigned char Time)
{
	unsigned char a;
	for(a=0;a<Time;a++)
	{
		NOP();
	}
}                  
/*-------------------------------------------------
 * 函数名：DelayMs
 * 功能：  短延时函数
 * 输入：  Time延时时间长度 延时时长Time ms
 * 输出：  无 
 -------------------------------------------------*/
void DelayMs(unsigned char Time)
{
	unsigned char a,b;
	for(a=0;a<Time;a++)
	{
		for(b=0;b<5;b++)
		{
		 	DelayUs(197); 	//快1%
		}
	}
}
/*-------------------------------------------------
 * 函数名：WDT_INITIAL
 * 功能：  初始化设置看门狗
 * 设置看门狗复位时间=系统时钟周期*预分频值*定时周期
 * 					 =1/32000*1*1024=23ms
 --------------------------------------------------*/
void WDT_INITIAL (void) 
{
	CLRWDT();              	//清看门狗
    MISC0 = 0B00000000;   	//看门狗时钟32k
	WDTCON = 0B00001011;   	//WDTPS=1010=1:1024,预分频1:1
}
/*-------------------------------------------------
 * 函数名：main 
 * 功能：  主函数
 * 输入：  无
 * 输出：  无
 --------------------------------------------------*/
void main(void)
{
	POWER_INITIAL();		//系统初始化
    WDT_INITIAL();
    
	DemoPortOut = 1; 
    DelayMs(3);         	//3ms
	DemoPortOut = 0;
	DelayMs(3); 	    	//3ms
	while(1)
	{	
	 	CLRWDT();       	//清看门狗
		DemoPortOut = 1; 
		DelayMs(1);     	//1ms
		DemoPortOut = 0; 
		DelayMs(1); 		//1ms
	}
}