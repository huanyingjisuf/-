#ifndef _MAIN_C_
#define _MAIN_C_
/*********************************************************************************************************************/
#include "include/ca51f1_config.h"		
#include "include/ca51f1sfr.h"
#include "include/ca51f1xsfr.h"
#include "include/gpiodef_f1.h"

#include "include/uart.h"
#include "include/delay.h"
#include <intrins.h>
/*********************************************************************************************************************
	引脚控制例程
*********************************************************************************************************************/
void main(void)
{	
#ifdef LVD_RST_ENABLE
	LVDCON = 0xE0;					//设置LVD复位电压为2.7V
#endif

#ifdef SYSCLK_16MHZ					//系统时钟为16MHz,设置CKDIV为0
	CKDIV = 0;
#endif

#ifdef UART_EN
	Uart_Initial(UART_BAUTRATE);	//初始化UART
#endif
	
	EA = 1;							//开全局中断

/********************************************************************************************************************/

	P01F = 2;						//P01设置为推挽输出模式
	while(1)
	{
		P01 = 1;					//输出高电平
		Delay_ms(1);
		P01 = 0;					//输出低电平
		Delay_ms(1);
	}

/********************************************************************************************************************/			

	P01F = 1;						//P00设置为输入模式
	while(1)
	{
		if(P01)
		{
		#ifdef PRINT_EN
			uart_printf("P01 Input High!\n");
		#endif
		}
		else
		{
		#ifdef PRINT_EN
			uart_printf("P01 Input Low!\n");
		#endif
		}
	}

//引脚功能设置，例如：
/********************************************************************************************************************/		
//P01设置为推挽输出，程序如下：
	P01F = 2;					
/********************************************************************************************************************/	
//P01设置为开漏输出，程序如下：
	P01F = (1<<5)|2;
/********************************************************************************************************************/
//P01设置为开漏输出，并且打开上拉，程序如下：
	P01F = (1<<7)|(1<<5)|2;		
/********************************************************************************************************************/	
//P01设置为输入功能，并且打开上拉，程序如下：
	P01F = (1<<7)|1;		
/********************************************************************************************************************/	
//P01设置为输入功能，并且打开下拉，程序如下：
	P01F = (1<<6)|1;
/********************************************************************************************************************/		
	
	while(1)
	{

	}
}
#endif
